## src/modules/custom_action_control/Kconfig
```kconfig
menuconfig MODULES_CUSTOM_ACTION_CONTROL
	bool "custom_action_control"
	default n
	---help---
		Enable the project SEARCH_TOP controller and legacy-control handover.
```

## src/modules/top_distance_bridge/Kconfig
```kconfig
menuconfig MODULES_TOP_DISTANCE_BRIDGE
	bool "top_distance_bridge"
	default n
	---help---
		Enable the dedicated four-laser MAVLink receiver.
```
